
// File Name: gprs.c

#include "gprs.h"
#include "systerm.h"
/*////////////////////////////////////////////////////////////////////////////////////////////////////
// 函数名:char Uart2Init(char smod,char brtx12,unsigned char reload)
// 作用:	初始化用于连接gprs的串口2 ,串口2只能设置为独立波特率提供波特率
			并打开串口2中断和全局中断
// 参数:	smod	s2smod位	0/1
			brtx12	brtx12位  0/1
			reload	reload寄存器数值  0-255
// 返回:	-1		s2smod位错误，没有写入0/1
			-2		brtx12位错误，没有写入0/1
			0		
////////////////////////////////////////////////////////////////////////////////////////////////////*/
char Uart2Init(char s2smod,char brtx12,unsigned char reload)
{
	S2CON = 0X50;//8位可变波特率，无奇偶位
	BRT	= reload;//设置独立波特率发生器波特率

	if(s2smod == 1)
	{
		AUXR |= S2SMOD;   //S2SMOD = 1;//波特率倍速位
	}
	else if(s2smod == 0)
	{
		AUXR &= (~S2SMOD);   //S2SMOD = 0;//取消波特率倍速位
	}
	else
	{
		return -1;
	}
		
	if(brtx12 == 1)
	{
		AUXR |= BRTx12;//BRTx12 = 1;1T模式	
	}
	else if(brtx12 == 0)
	{
		AUXR &= (~BRTx12);//BRTx12 = 0;12T模式		
	}
	else
	{
		return -2;
	}
		
	AUXR |= BRTR;//开启波特率发生器																				
	IE2 |= ES2;//	ES2 = 1;	   //允许串口2中断
	EA = 1;	   //开总中断
	return 0;	
}

/*////////////////////////////////////////////////////////////////////////////////////////////////////
// 函数名:void Uart2Send(char i)
// 作用: 用于gprs连接的串口1向gps发送1字节数据
// 参数:	i	要发送的数据	
// 返回:	 void
////////////////////////////////////////////////////////////////////////////////////////////////////*/
void Uart2Send(uchar i)
{
	unsigned char temp = 0;
	
	IE2 &= (~ES2);//关闭串口2中断//ES2 = 0;
	S2CON &= (~S2TI);//S2TI = 0;
	S2BUF = i;//装入数据
	do
	{
		temp = S2CON;
		temp = temp & 0x02;//temp = S2TI;
	}while(temp == 0);//判断是否发送完毕

	S2CON &= (~S2TI);//S2TI = 0;
	IE2 |= ES2;//ES2 = 1;
		
}

/*////////////////////////////////////////////////////////////////////////////////////////////////////
// 函数名:void Uart2Sends(char* data_at)
// 作用:	发送字符串到串口2 
// 参数:	char* data_at 字符串头地址
// 返回:
////////////////////////////////////////////////////////////////////////////////////////////////////*/
void Uart2Sends(uchar* data_at)
{

	unsigned char cnt=0;

	IE2 &= (~ES2);//关闭串口2中断//ES2 = 0;
	S2CON &= (~S2TI);//S2TI = 0;

			
	while(*(data_at+cnt))	//判断一串数据是否结束
	{
		S2BUF = *(data_at+cnt);//装入数据
		while((S2CON & S2TI) == 0);
		S2CON &= (~S2TI);//S2TI = 0;
		cnt++;

	}

	S2CON &= (~S2TI);//S2TI = 0;
	IE2 |= ES2;//ES2 = 1;		
}






/*////////////////////////////////////////////////////////////////////////////////////////////////////
// 函数名:char Uart1Init(char smod,char brtx12,unsigned char reload)
// 作用:	初始化用于连接gps的串口1 ,将串口1设置位独立波特率发生器提供波特率，
			并打开串口1中断和全局中断
// 参数:	smod	smod位	0/1
			brtx12	brtx12位  0/1
			reload	reload寄存器数值  0-255
// 返回:	-1		smod位错误，没有写入0/1
			-2		brtx12位错误，没有写入0/1
			0		
////////////////////////////////////////////////////////////////////////////////////////////////////*/
//串口设置位独立波特率提供波特率，和串口2使用同一个波特率，也可以使用定时器1来提供波特率
char Uart1Init(char smod,char brtx12,unsigned char reload)
{
	SCON =  0X50;//8位可变波特率，无奇偶位(SM0=0,SM1=1),使能串口接收模块(REN=1)
	BRT	= reload;//设置独立波特率发生器波特率

	if(smod == 1)
	{
		PCON |= SMOD;   //SMOD = 1;//波特率倍速位
	}
	else if(smod == 0)
	{
		PCON &= (~SMOD);   //SMOD = 0;//取消波特率倍速位
	}
	else
	{
		return -1;
	}
		
	if(brtx12 == 1)
	{
		AUXR |= BRTx12;//BRTx12 = 1;1T模式	
	}
	else if(brtx12 == 0)
	{
		AUXR &= (~BRTx12);//BRTx12 = 0;12T模式		
	}
	else
	{
		return -2;
	}
	
  	AUXR |= S1BRS;//串口1设置为使用独立波特率发生器										
	AUXR |= BRTR;//开启波特率发生器									
											
	ES = 1;	   //开串口中断
	EA = 1;	   //开总中断
	return 0;	
}

/*////////////////////////////////////////////////////////////////////////////////////////////////////
// 函数名:void Uart1Send(char i)
// 作用: 用于gps连接的串口1向gps发送1字节数据
// 参数:	i	要发送的数据	
// 返回:	 void
////////////////////////////////////////////////////////////////////////////////////////////////////*/
void Uart1Send(uchar i)
{
	ES = 0; //关串口中断
	TI = 0; //清空发送完中断请求标志位
	SBUF = i;  //将数据放入寄存器发送
	while(TI == 0);//等待发送完毕，发送完毕 TI == 1
	TI = 0;	//清空发送完中断请求标志位
	ES = 1;	 //开串口中断	
}

/*////////////////////////////////////////////////////////////////////////////////////////////////////
// 函数名:void Uart1Sends(char* at)
// 作用: 发送字符串到串口1
// 参数: char* at 字符串头地址
// 返回:
////////////////////////////////////////////////////////////////////////////////////////////////////*/
void Uart1Sends(uchar* at)
{
	unsigned char cnt=0;

	ES=0;//关串行口中断	
	while(*(at+cnt))	//判断一串数据是否结束
	{
		SBUF=*(at+cnt);	//发送数据
		while(TI==0);	//查询发送是否结束
		TI=0;	//清除发送一标志位
		cnt++;	//准备发送一个数据
	}
	ES=1;//开串行口中断		
}

/*////////////////////////////////////////////////////////////////////////////////////////////////////
// 函数名: void Uart1InterruptReceive(void) interrupt 4
// 作用: 	接收gps模块传来的定位信号，并将GPRMC信息中的各种信息存入gprmc结构体内，详见gprmc结构体
// 参数:	void
// 返回:	void
////////////////////////////////////////////////////////////////////////////////////////////////////*/
void Uart1InterruptReceive(void) interrupt 4
{
	char tmp = 0;
	unsigned char i = 0;
	if(RI)
	{

		ES=0;//关串行口中断
		RI=0;//接收中断信号清零，表示将继续接收
		while(RI!=0);
		while(ES!=0);


		tmp = SBUF;
		ES=1;//开串行口中断	
	}	
}






/*////////////////////////////////////////////////////////////////////////////////////////////////////
// 函数名: void Uart2InterruptReceive(void)
// 作用:  串口2的中断函数，用于保存接收到的gprs传来的数据，
			当 GprsFlagInfoAble=1，时说明当前保存到gprs_dat_recv[0]-gprs_dat_recv[GprsRecvCntAt]中存放的是一个完整的at回复指令，
			必须马上读出出来，否则下一个数据到来后该指令将被取代。
			 GprsFlagInfoStart 在接收信息时该位置1，接收完一组完整at回复指令清0
// 参数:  void
// 返回:  void
////////////////////////////////////////////////////////////////////////////////////////////////////*/
void Uart2InterruptReceive(void) interrupt 8
{
	unsigned char tmp = 0;
	char i = 0;

	IE2 &= (~ES2);//关闭串口2中断//ES2 = 0;
	if(S2CON & S2RI)	//if(S2RI == 1)
	{

		S2CON &= (~S2RI);//S2RI = 0;
		tmp = S2BUF;
		Uart1Send(tmp);
	}
	else
	{
		S2CON &= (~S2TI);//S2TI = 0;
	}

	IE2 |= ES2;//ES2 = 1;
}











